## config/boards/shields/3waysplit/Kconfig.defconfig
```kconfig
if SHIELD_3WAYSPLIT_LEFT || SHIELD_3WAYSPLIT_RIGHT

config ZMK_KEYBOARD_NAME
    default "3WaySplit"
    
config ZMK_SPLIT_ROLE_CENTRAL
    default y
endif

if SHIELD_3WAYSPLIT_LEFT || SHIELD_3WAYSPLIT_RIGHT || SHIELD_3WAYSPLIT_NUMPAD

config ZMK_SPLIT
    default y

endif
```

## config/boards/shields/3waysplit/Kconfig.shield
```kconfig
config SHIELD_3WAYSPLIT_LEFT
    def_bool $(shields_list_contains, 3waysplit_left)

config SHIELD_3WAYSPLIT_RIGHT
    def_bool $(shields_list_contains, 3waysplit_right)

config SHIELD_3WAYSPLIT_NUMPAD
    def_bool $(shields_list_contains, 3waysplit_numpad)
```
